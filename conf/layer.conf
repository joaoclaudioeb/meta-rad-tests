## conf/layer.conf
```bitbake
# We have a conf and classes directory, add to BBPATH
BBPATH .= ":${LAYERDIR}"

# We have recipes-* directories, add to BBFILES
BBFILES += "${LAYERDIR}/recipes-*/*/*.bb \
            ${LAYERDIR}/recipes-*/*/*.bbappend"

BBFILE_COLLECTIONS += "rad-tests"
BBFILE_PATTERN_rad-tests = "^${LAYERDIR}/"
BBFILE_PRIORITY_rad-tests = "9"

LAYERDEPENDS_rad-tests = "core"
LAYERDEPENDS_rad-tests += "openembedded-layer"

LAYERSERIES_COMPAT_rad-tests = "langdale"
```
